## boards/arm/treo650/Kconfig.defconfig
```kconfig
if BOARD_TREO650

config ZMK_KEYBOARD_NAME
    default "treo650"

if USB_DEVICE_STACK

config USB_NRFX
    default y

endif # USB_DEVICE_STACK

config BT_CTLR
    default BT

endif # BOARD_TREO650
```

## boards/shields/treo650/Kconfig.shield
```kconfig
# No whitespace after the comma or in your keyboard name!
config SHIELD_TREO650
    def_bool $(shields_list_contains,treo650)
```

## boards/treo650/Kconfig.defconfig
```kconfig
if BOARD_TREO650

config ZMK_KEYBOARD_NAME
    default "treo650"

if USB_DEVICE_STACK

config USB_NRFX
    default y

endif # USB_DEVICE_STACK

if ZMK_BACKLIGHT

config PWM
    default y

config LED_PWM
    default y

endif # ZMK_BACKLIGHT

config BT_CTLR
    default BT

endif # BOARD_TREO650
```
